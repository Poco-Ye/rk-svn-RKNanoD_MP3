;
;*******************************************************************************
;                   Copyright (c) 2008,ZhengYongzhi
;                         All rights reserved.
;
; File Name:   CortexM3.sct
;
; Description:
;
; History:      <author>          <time>        <version>
;             ZhengYongzhi      2008-8-13          1.0
;    desc:    ORG.
;*******************************************************************************
;
#define BOOT_ROM_BASE       0x00000000

#define HRAM_CODE_BASE      0x01000000
#define HRAM_CODE_SIZE      0x00020000

#define HRAM_DATA_BASE      0x01020000
#define HRAM_DATA_SIZE      0x00040000

#define LOADER_DATA_BASE    0x0304A000
#define LOADER_CODE_BASE    0x03088000

#ifdef DRIVER_TEST
#define TEST_DATA_BASE      0x0304A000
#define TEST_DATA_SIZE      0x6000
#define TEST_CODE_BASE      0x03088000
#define TEST_CODE_SIZE      0x8000
#else
#define TEST_DATA_BASE      0x0304A000
#define TEST_DATA_SIZE      4
#define TEST_CODE_BASE      0x03088000
#define TEST_CODE_SIZE      4
#endif

#define SYS_DATA_BASE       0x03000000
#define SYS_DATA_SIZE       (0x00050000 - TEST_DATA_SIZE)
#define SYS_DATA_LIMIT      (0x03050000 - TEST_DATA_SIZE)

#define SYS_CODE_BASE       0x03050000
#define SYS_CODE_SIZE       (0x00050000 - TEST_CODE_SIZE)
#define SYS_CODE_LIMIT      (0x030A0000 - TEST_CODE_SIZE)

#define PMU_DATA_BASE       0x00000000
#define PMU_DATA_SIZE       0x0000E000
#define PMU_CODE_BASE       0x0000E000
#define PMU_CODE_SIZE       0x00001000

START_REGION 0x04000000
{
    START 0x04000000
    {
        *(link_entry)
    }
}

LOAD_REGION SYS_CODE_BASE  OVERLAY
{
    ;--------------------------------------------------------------
    ;Module Info Table
    MODULE_INFO 0x21000000
    {
        *.o(ModuleInfo)
    }
    ;--------------------------------------------------------------
    ;VOCIE_NOTIFY_8K
    SEID0000_8K_CODE 0x31000000
    {
        *(Seid0000_8K)
    }
    SEID0001_8K_CODE 0x32000000
    {
        *(Seid0001_8K)
    }
    SEID0002_8K_CODE 0x33000000
    {
        *(Seid0002_8K)
    }
    SEID0003_8K_CODE 0x34000000
    {
        *(Seid0003_8K)
    }
    SEID0004_8K_CODE 0x35000000
    {
        *(Seid0004_8K)
    }
    SEID0005_8K_CODE 0x36000000
    {
        *(Seid0005_8K)
    }
    SEID0006_8K_CODE 0x37000000
    {
        *(Seid0006_8K)
    }
    SEID0007_8K_CODE 0x38000000
    {
        *(Seid0007_8K)
    }
    ;--------------------------------------------------------------
    ;VOCIE_NOTIFY_11K
    SEID0000_11K_CODE 0x39000000
    {
        *(Seid0000_11K)
    }
    SEID0001_11K_CODE 0x3A000000
    {
        *(Seid0001_11K)
    }
    SEID0002_11K_CODE 0x3B000000
    {
        *(Seid0002_11K)
    }
    SEID0003_11K_CODE 0x3C000000
    {
        *(Seid0003_11K)
    }
    SEID0004_11K_CODE 0x3D000000
    {
        *(Seid0004_11K)
    }
    SEID0005_11K_CODE 0x3E000000
    {
        *(Seid0005_11K)
    }
    SEID0006_11K_CODE 0x3F000000
    {
        *(Seid0006_11K)
    }
    SEID0007_11K_CODE 0x41000000
    {
        *(Seid0007_11K)
    }
    ;--------------------------------------------------------------
    ;VOCIE_NOTIFY_12K
    SEID0000_12K_CODE 0x42000000
    {
        *(Seid0000_12K)
    }
    SEID0001_12K_CODE 0x43000000
    {
        *(Seid0001_12K)
    }
    SEID0002_12K_CODE 0x44000000
    {
        *(Seid0002_12K)
    }
    SEID0003_12K_CODE 0x45000000
    {
        *(Seid0003_12K)
    }
    SEID0004_12K_CODE 0x46000000
    {
        *(Seid0004_12K)
    }
    SEID0005_12K_CODE 0x47000000
    {
        *(Seid0005_12K)
    }
    SEID0006_12K_CODE 0x48000000
    {
        *(Seid0006_12K)
    }
    SEID0007_12K_CODE 0x49000000
    {
        *(Seid0007_12K)
    }
    ;--------------------------------------------------------------
    ;VOCIE_NOTIFY_16K
    SEID0000_16K_CODE 0x4A000000
    {
        *(Seid0000_16K)
    }
    SEID0001_16K_CODE 0x4B000000
    {
        *(Seid0001_16K)
    }
    SEID0002_16K_CODE 0x4C000000
    {
        *(Seid0002_16K)
    }
    SEID0003_16K_CODE 0x4D000000
    {
        *(Seid0003_16K)
    }
    SEID0004_16K_CODE 0x4E000000
    {
        *(Seid0004_16K)
    }
    SEID0005_16K_CODE 0x4F000000
    {
        *(Seid0005_16K)
    }
    SEID0006_16K_CODE 0x51000000
    {
        *(Seid0006_16K)
    }
    SEID0007_16K_CODE 0x52000000
    {
        *(Seid0007_16K)
    }
    ;--------------------------------------------------------------
    ;VOCIE_NOTIFY_22K
     SEID0000_22K_CODE 0x53000000
    {
        *(Seid0000_22K)
    }
    SEID0001_22K_CODE 0x54000000
    {
        *(Seid0001_22K)
    }
    SEID0002_22K_CODE 0x55000000
    {
        *(Seid0002_22K)
    }
    SEID0003_22K_CODE 0x56000000
    {
        *(Seid0003_22K)
    }
    SEID0004_22K_CODE 0x57000000
    {
        *(Seid0004_22K)
    }
    SEID0005_22K_CODE 0x58000000
    {
        *(Seid0005_22K)
    }
    SEID0006_22K_CODE 0x59000000
    {
        *(Seid0006_22K)
    }
    SEID0007_22K_CODE 0x5A000000
    {
        *(Seid0007_22K)
    }
    ;--------------------------------------------------------------
    ;VOCIE_NOTIFY_24K
    SEID0000_24K_CODE 0x5B000000
    {
        *(Seid0000_24K)
    }
    SEID0001_24K_CODE 0x5C000000
    {
        *(Seid0001_24K)
    }
    SEID0002_24K_CODE 0x5D000000
    {
        *(Seid0002_24K)
    }
    SEID0003_24K_CODE 0x5E000000
    {
        *(Seid0003_24K)
    }
    SEID0004_24K_CODE 0x5F000000
    {
        *(Seid0004_24K)
    }
    SEID0005_24K_CODE 0x60000000
    {
        *(Seid0005_24K)
    }
    SEID0006_24K_CODE 0x61000000
    {
        *(Seid0006_24K)
    }
    SEID0007_24K_CODE 0x62000000
    {
        *(Seid0007_24K)
    }
    ;--------------------------------------------------------------
    ;VOCIE_NOTIFY_32K
    SEID0000_32K_CODE 0x63000000
    {
        *(Seid0000_32K)
    }
    SEID0001_32K_CODE 0x64000000
    {
        *(Seid0001_32K)
    }
    SEID0002_32K_CODE 0x65000000
    {
        *(Seid0002_32K)
    }
    SEID0003_32K_CODE 0x66000000
    {
        *(Seid0003_32K)
    }
    SEID0004_32K_CODE 0x67000000
    {
        *(Seid0004_32K)
    }
    SEID0005_32K_CODE 0x68000000
    {
        *(Seid0005_32K)
    }
    SEID0006_32K_CODE 0x69000000
    {
        *(Seid0006_32K)
    }
    SEID0007_32K_CODE 0x6A000000
    {
        *(Seid0007_32K)
    }
    ;--------------------------------------------------------------
    ;VOCIE_NOTIFY_441K
    SEID0000_44K_CODE 0x6B000000
    {
        *(Seid0000_44K)
    }
    SEID0001_44K_CODE 0x6C000000
    {
        *(Seid0001_44K)
    }
    SEID0002_44K_CODE 0x6D000000
    {
        *(Seid0002_44K)
    }
    SEID0003_44K_CODE 0x6E000000
    {
        *(Seid0003_44K)
    }
    SEID0004_44K_CODE 0x6F000000
    {
        *(Seid0004_44K)
    }
    SEID0005_44K_CODE 0x70000000
    {
        *(Seid0005_44K)
    }
    SEID0006_44K_CODE 0x71000000
    {
        *(Seid0006_44K)
    }
    SEID0007_44K_CODE 0x72000000
    {
        *(Seid0007_44K)
    }
    ;--------------------------------------------------------------
    ;VOCIE_NOTIFY_48K
    SEID0000_48K_CODE 0x73000000
    {
        *(Seid0000_48K)
    }
    SEID0001_48K_CODE 0x74000000
    {
        *(Seid0001_48K)
    }
    SEID0002_48K_CODE 0x75000000
    {
        *(Seid0002_48K)
    }
    SEID0003_48K_CODE 0x76000000
    {
        *(Seid0003_48K)
    }
    SEID0004_48K_CODE 0x77000000
    {
        *(Seid0004_48K)
    }
    SEID0005_48K_CODE 0x78000000
    {
        *(Seid0005_48K)
    }
    SEID0006_48K_CODE 0x79000000
    {
        *(Seid0006_48K)
    }
    SEID0007_48K_CODE 0x7A000000
    {
        *(Seid0007_48K)
    }
    ;--------------------------------------------------------------
    ;ASIC_TO_UNICODE_TABLE
    CP1251_UNICODE_TABLE_CODE 0x81000000
    {
       *(Cp1251_Unicode_Table)
    }
    CP932_UNICODE_TABLE_CODE 0x82000000
    {
        *(Cp932_Unicode_Table)
    }
    CP932_UNICODE_TABLE1_CODE 0x83000000
    {
        *(Cp932_Unicode_Table1)
    }
    CP932_UNICODE_TABLE2_CODE 0x84000000
    {
        *(Cp932_Unicode_Table2)
    }
    CP950_UNICODE_TABLE_CODE 0x85000000
    {
        *(Cp950_Unicode_Table)
    }
    CP949_UNICODE_TABLE_CODE 0x86000000
    {
        *(Cp949_Unicode_Table)
    }
    CP949_UNICODE_TABLE1_CODE 0x87000000
    {
        *(Cp949_Unicode_Table1)
    }

    BT_INIT_SCRIPT_CODE (0x87100000)
    {
        *(LwbtInitScriptCode)
    }
;
;==============================================================================
;
;   System Section
;
;==============================================================================
;
    SYS_CODE (SYS_CODE_BASE)    OVERLAY
    {
        *.o(START_VECT, +First)
        *.o(START_CODE)

        *(SysCode)

        *(FlashCode)
        *(FatCode)

        *(DialogBoxCode)
        *(MessageBoxCode)
        *(DialogHoldCode)
        *(LowPowerBoxCode)
        *(DriverLib)

        *(FatData)
        *(FatBss)

        *(+RO)
    }

    AP_MAIN_STACK (SYS_DATA_BASE)
    {
        *(APMainStack)
    }
    SYS_DATA (ImageLimit(AP_MAIN_STACK))    OVERLAY
    {
        *.o(vect, +First)
        *(+RW)
        *(+ZI)
    }

    LCD_DRIVER1_CODE(ImageLimit(SYS_CODE)) OVERLAY
    {
        *(UC1604CDriverCode)

        *(ST7735DriverCode)
    }
    LCD_DRIVER1_DATA(ImageLimit(SYS_DATA)) OVERLAY
    {
        *(UC1604CDriverData)
        *(UC1604CDriverBss)

        *(ST7735DriverData)
        *(ST7735DriverBss)
    }
    LCD_DRIVER2_CODE(ImageLimit(SYS_CODE)) OVERLAY
    {
        *(ST7735SDriverCode)
    }
    LCD_DRIVER2_DATA(ImageLimit(SYS_DATA)) OVERLAY
    {
        *(ST7735SDriverData)
        *(ST7735SDriverBss)

    }
    #define LCD_DRIVER_CODE_END  ((ImageLimit(LCD_DRIVER2_CODE)>ImageLimit(LCD_DRIVER1_CODE))?ImageLimit(LCD_DRIVER2_CODE):ImageLimit(LCD_DRIVER1_CODE))
    #define LCD_DRIVER_DATA_END  ((ImageLimit(LCD_DRIVER2_DATA)>ImageLimit(LCD_DRIVER1_DATA))?ImageLimit(LCD_DRIVER2_DATA):ImageLimit(LCD_DRIVER1_DATA))

    FLASH_WRITE_CODE (LCD_DRIVER_CODE_END) OVERLAY                  ;FlashWrite Code
    {

    }
    FLASH_WRITE_DATA (LCD_DRIVER_DATA_END) OVERLAY                  ;FlashWrite Data
    {

    }

    SYS_INIT_CODE (ImageLimit(FLASH_WRITE_CODE)) OVERLAY
    {
        *(SysInitCode)
        *(FlashInitCode)
        *(FatInitCode)
        ;*(SDInitCode)
    }
    SYS_INIT_DATA (ImageLimit(FLASH_WRITE_DATA)) OVERLAY
    {
        *(SysInitData)
        *(FlashInitData)
        *(FatInitData)
        ;*(SDInitData)

        *(SysInitBss)
        *(FlashInitBss)
        *(FatInitBss)
        ;*(SDInitBss)
    }
    SYS_INIT_CODE_END (ImageLimit(SYS_INIT_CODE)) OVERLAY {}
    SYS_INIT_DATA_END (ImageLimit(SYS_INIT_DATA)) OVERLAY {}

    ScatterAssert(ImageLimit(SYS_INIT_CODE) < LOADER_CODE_BASE)
    ScatterAssert(ImageLimit(SYS_INIT_DATA) < LOADER_DATA_BASE)

    ;--------------------------------------------------------------
    ;System end
    #define SYS_CODE_END  ImageLimit(FLASH_WRITE_CODE)
    #define SYS_DATA_END  ImageLimit(FLASH_WRITE_DATA)

;
;==============================================================================
;
;   USB Section
;
;==============================================================================
;
    USBWIN_CODE (SYS_CODE_END) OVERLAY                          ;USB UI CODE
    {
        *(UsbUICode)
    }
    USBWIN_DATA (SYS_DATA_END) OVERLAY                          ;USB UI DATA
    {
        *(UsbUIData)
        *(UsbUIBss)
    }

    USBCONTROL_CODE (ImageLimit(USBWIN_CODE)) OVERLAY           ;USB CONTROL CODE
    {
        *(UsbDriverCode)
        *(UsbControlCode)
    }
    USBCONTROL_DATA (ImageLimit(USBWIN_DATA)) OVERLAY           ;USB CONTROL DATA
    {
        *(UsbDriverData)
        *(UsbDriverBss)
        *(UsbControlData)
        *(UsbControlBss)
    }

    USBMSC_CODE (ImageLimit(USBCONTROL_CODE)) OVERLAY           ;USB MSC CODE
    {
        *(UsbMSCCode)
    }
    USBMSC_DATA (ImageLimit(USBCONTROL_DATA)) OVERLAY           ;USB MSC DATA
    {
        *(UsbMSCData)
        *(UsbMSCBss)
        *(UsbBulkBss)
        storage.o(+RW)
        storage.o(+ZI)
    }
    USBMSC_CODE_END (ImageLimit(USBMSC_CODE)) OVERLAY {}
    USBMSC_DATA_END (ImageLimit(USBMSC_DATA)) OVERLAY {}

    ScatterAssert(ImageLimit(USBMSC_CODE) < (SYS_CODE_BASE + SYS_CODE_SIZE))
    ScatterAssert(ImageLimit(USBMSC_DATA) < (SYS_DATA_BASE + SYS_DATA_SIZE))

;
;==============================================================================
;
;   UI Section
;
;==============================================================================
;
    #define UI_CODE_BASE  SYS_CODE_END
    #define UI_DATA_BASE  SYS_DATA_END

    ;--------------------------------------------------------------
    CHARGE_WIN_CODE (UI_CODE_BASE) OVERLAY
    {
        *(ChargeWinCode)
    }

    CHARGE_WIN_DATA (UI_DATA_BASE) OVERLAY
    {
        *(ChargeWinData)
        *(ChargeWinBss)
    }
    CHARGE_WIN_CODE_END (ImageLimit(CHARGE_WIN_CODE)) OVERLAY {}
    CHARGE_WIN_DATA_END (ImageLimit(CHARGE_WIN_DATA)) OVERLAY {}

    ;--------------------------------------------------------------
    MAINMENU_CODE (UI_CODE_BASE) OVERLAY                            ;MainMenu Main Code
    {
        *(MainMenuCode)
        *(MainMenuInitCode)
        *(MainMenuDeInitCode)
        *(MainMenuServiceCode)
    }
    MAINMENU_DATA (UI_DATA_BASE) OVERLAY                            ;MainMenu Main Data
    {
        *(MainMenuData)
        *(MainMenuBss)
        *(MainMenuInitData)
        *(MainMenuDeInitData)
        *(MainMenuInitBss)
        *(MainMenuDeInitBss)
        *(MainMenuServiceData)
        *(MainMenuServiceBss)
    }
    MAINMENU_CODE_END (ImageLimit(MAINMENU_CODE)) OVERLAY {}
    MAINMENU_DATA_END (ImageLimit(MAINMENU_DATA)) OVERLAY {}
    #define MAX_MAINMENU_CODE   (ImageLimit(MAINMENU_CODE))
    #define MAX_MAINMENU_DATA   (ImageLimit(MAINMENU_DATA))

    ;--------------------------------------------------------------
    MDB_WIN_CODE (UI_CODE_BASE) OVERLAY
    {
        *(MdbBuildWinCode)
    }

    MDB_WIN_DATA (UI_DATA_BASE) OVERLAY
    {
        *(MdbBuildWinData)
        *(MdbBuildWinBss)
    }
    MDB_WIN_CODE_END (ImageLimit(MDB_WIN_CODE)) OVERLAY {}
    MDB_WIN_DATA_END (ImageLimit(MDB_WIN_DATA)) OVERLAY {}
    #define MAX_MDB_WIN_CODE        ((MAX_MAINMENU_CODE > ImageLimit(MDB_WIN_CODE)) ? MAX_MAINMENU_CODE : ImageLimit(MDB_WIN_CODE))
    #define MAX_MDB_WIN_DATA        ((MAX_MAINMENU_DATA > ImageLimit(MDB_WIN_DATA)) ? MAX_MAINMENU_DATA : ImageLimit(MDB_WIN_DATA))

    ;--------------------------------------------------------------
    MEDIALIBWIN_CODE (UI_CODE_BASE) OVERLAY
    {
        *(MediaWinCode)
        *(MediaWinInitCode)
        *(MediaWinDeInitCode)
        *(MediaWinServiceCode)
    }
    MEDIALIBWIN_DATA (UI_DATA_BASE) OVERLAY
    {
        *(MediaWinData)
        *(MediaWinBss)
        *(MediaWinInitData)
        *(MediaWinInitBss)
        *(MediaWinDeInitData)
        *(MediaWinDeInitBss)
        *(MediaWinServiceData)
        *(MediaWinServiceBss)
    }
    MEDIALIBWIN_CODE_END (ImageLimit(MEDIALIBWIN_CODE)) OVERLAY {}
    MEDIALIBWIN_DATA_END (ImageLimit(MEDIALIBWIN_DATA)) OVERLAY {}
    #define MAX_MEDIALIB_CODE       ((MAX_MDB_WIN_CODE > ImageLimit(MEDIALIBWIN_CODE)) ? MAX_MDB_WIN_CODE : ImageLimit(MEDIALIBWIN_CODE))
    #define MAX_MEDIALIB_DATA       ((MAX_MDB_WIN_DATA > ImageLimit(MEDIALIBWIN_DATA)) ? MAX_MDB_WIN_DATA : ImageLimit(MEDIALIBWIN_DATA))

    ;--------------------------------------------------------------
    MEDIABROWIN_CODE (UI_CODE_BASE) OVERLAY
    {
        *(MediaBroCode)
        *(MediaBroInitCode)
        *(MediaBroDeInitCode)
        *(MediaBroServiceCode)
    }
    MEDIABROWIN_DATA (UI_DATA_BASE) OVERLAY
    {
        *(MediaBroData)
        *(MediaBroBss)
        *(MediaBroInitData)
        *(MediaBroInitBss)
        *(MediaBroDeInitData)
        *(MediaBroDeInitBss)
        *(MediaBroServiceData)
        *(MediaBroServiceBss)
    }
    MEDIABRO_SORTGET_CODE (ImageLimit(MEDIABROWIN_CODE)) OVERLAY
    {
        *(MediaBroSortGetCode)
    }
    MEDIABRO_SORTGET_DATA (ImageLimit(MEDIABROWIN_DATA)) OVERLAY
    {
        *(MediaBroSortGetData)
        *(MediaBroSortGetBss)
    }
    MEDIABRO_SORTGET_CODE_END (ImageLimit(MEDIABRO_SORTGET_CODE)) OVERLAY {}
    MEDIABRO_SORTGET_DATA_END (ImageLimit(MEDIABRO_SORTGET_DATA)) OVERLAY {}

    MEDIABROSUBWIN_CODE   (ImageLimit(MEDIABROWIN_CODE)) OVERLAY
    {
        *(MediaBroSubCode)
    }
    MEDIABROSUBWIN_DATA   (ImageLimit(MEDIABROWIN_DATA)) OVERLAY
    {
        *(MediaBroSubData)
        *(MediaBroSubBss)
    }
    MEDIABROSUBWIN_CODE_END (ImageLimit(MEDIABROSUBWIN_CODE)) OVERLAY {}
    MEDIABROSUBWIN_DATA_END (ImageLimit(MEDIABROSUBWIN_DATA)) OVERLAY {}
    #define MAX_MEDIABROSUBWIN_CODE ((ImageLimit(MEDIABRO_SORTGET_CODE) > ImageLimit(MEDIABROSUBWIN_CODE)) ? ImageLimit(MEDIABRO_SORTGET_CODE) : ImageLimit(MEDIABROSUBWIN_CODE))
    #define MAX_MEDIABROSUBWIN_DATA ((ImageLimit(MEDIABRO_SORTGET_DATA) > ImageLimit(MEDIABROSUBWIN_DATA)) ? ImageLimit(MEDIABRO_SORTGET_DATA) : ImageLimit(MEDIABROSUBWIN_DATA))

    MEDIAFAVOSUBWIN_CODE  (ImageLimit(MEDIABROWIN_CODE)) OVERLAY
    {
        *(MediaFavoSubCode)
    }
    MEDIAFAVOSUBWIN_DATA  (ImageLimit(MEDIABROWIN_DATA)) OVERLAY
    {
        *(MediaFavoSubData)
        *(MediaFavoSubBss)
    }
    MEDIAFAVOSUBWIN_CODE_END (ImageLimit(MEDIAFAVOSUBWIN_CODE)) OVERLAY {}
    MEDIAFAVOSUBWIN_DATA_END (ImageLimit(MEDIAFAVOSUBWIN_DATA)) OVERLAY {}

    #define FAVORESET_CODE_BASE ((ImageLimit(MDB_WIN_CODE) > ImageLimit(MEDIAFAVOSUBWIN_CODE)) ? ImageLimit(MDB_WIN_CODE) : ImageLimit(MEDIAFAVOSUBWIN_CODE))
    #define FAVORESET_DATA_BASE ((ImageLimit(MDB_WIN_DATA) > ImageLimit(MEDIAFAVOSUBWIN_DATA)) ? ImageLimit(MDB_WIN_DATA) : ImageLimit(MEDIAFAVOSUBWIN_DATA))
    FAVORESET_CODE (FAVORESET_CODE_BASE)   OVERLAY
    {
        *(FavoResetCode)
    }
    FAVORESET_DATA (FAVORESET_DATA_BASE)   OVERLAY
    {
        *(FavoResetData)
        *(FavoResetBss)
    }
    FAVORESET_CODE_END (ImageLimit(FAVORESET_CODE)) OVERLAY {}
    FAVORESET_DATA_END (ImageLimit(FAVORESET_DATA)) OVERLAY {}
    #define MAX_MEDIAFAVOSUBWIN_CODE    ((MAX_MEDIABROSUBWIN_CODE > ImageLimit(FAVORESET_CODE)) ? MAX_MEDIABROSUBWIN_CODE : ImageLimit(FAVORESET_CODE))
    #define MAX_MEDIAFAVOSUBWIN_DATA    ((MAX_MEDIABROSUBWIN_DATA > ImageLimit(FAVORESET_DATA)) ? MAX_MEDIABROSUBWIN_DATA : ImageLimit(FAVORESET_DATA))

    #define MAX_MEDIABROWIN_CODE        ((MAX_MEDIALIB_CODE > MAX_MEDIAFAVOSUBWIN_CODE) ? MAX_MEDIALIB_CODE : MAX_MEDIAFAVOSUBWIN_CODE)
    #define MAX_MEDIABROWIN_DATA        ((MAX_MEDIALIB_DATA > MAX_MEDIAFAVOSUBWIN_DATA) ? MAX_MEDIALIB_DATA : MAX_MEDIAFAVOSUBWIN_DATA)
    MEDIABROWIN_CODE_END (MAX_MEDIABROWIN_CODE) OVERLAY {}
    MEDIABROWIN_DATA_END (MAX_MEDIABROWIN_DATA) OVERLAY {}

    ;--------------------------------------------------------------
    MUSICWIN_CODE (UI_CODE_BASE) OVERLAY                            ;MusicWin Main Code
    {
        *(MusicCode)
        *(MusicInitCode)
        *(MusicDeInitCode)
        *(MusicServiceCode)
        *(MusicLrcCode)
        *(MusicLrcInitCode)
        *(MusicLrcCommonCode)
    }
    MUSICWIN_DATA (UI_DATA_BASE) OVERLAY                            ;MusicWin Main Data
    {
        *(MusicData)
        *(MusicBss)
        *(MusicInitData)
        *(MusicDeInitData)
        *(MusicInitBss)
        *(MusicDeInitBss)
        *(MusicServiceData)
        *(MusicServiceBss)
        *(MusicLrcInitData)
        *(MusicLrcPlayData)
        *(MusicLrcInitBss)
        *(MusicLrcPlayBss)
        *(MusicLrcCommonData)
        *(MusicLrcCommonBss)
    }
    MUSICWIN_CODE_END (ImageLimit(MUSICWIN_CODE)) OVERLAY {}
    MUSICWIN_DATA_END (ImageLimit(MUSICWIN_DATA)) OVERLAY {}
    #define MAX_MUSICWIN_CODE  ((MAX_MEDIABROWIN_CODE > ImageLimit(MUSICWIN_CODE)) ? MAX_MEDIABROWIN_CODE : ImageLimit(MUSICWIN_CODE))
    #define MAX_MUSICWIN_DATA  ((MAX_MEDIABROWIN_DATA > ImageLimit(MUSICWIN_DATA)) ? MAX_MEDIABROWIN_DATA : ImageLimit(MUSICWIN_DATA))

    ;--------------------------------------------------------------
    RADIOWIN_CODE (UI_CODE_BASE) OVERLAY                            ;RadioWin Main Code
    {
        *(RadioWinCode)
        *(RadioSubWinCode)
        *(RadioWinInitCode)
        *(RadioWinDeInitCode)

        *(RadioWinServiceCode)
    }
    RADIOWIN_DATA (UI_DATA_BASE) OVERLAY                            ;RadioWin Main Data
    {
        *(RadioWinData)
        *(RadioWinBss)

        *(RadioSubWinData)
        *(RadioSubWinBss)

        *(RadioWinInitData)
        *(RadioWinDeInitData)
        *(RadioWinInitBss)
        *(RadioWinDeInitBss)

        *(RadioWinServiceData)
        *(RadioWinServiceBss)
    }
    RADIOWIN_CODE_END (ImageLimit(RADIOWIN_CODE)) OVERLAY {}
    RADIOWIN_DATA_END (ImageLimit(RADIOWIN_DATA)) OVERLAY {}
    #define MAX_RADIOWIN_CODE  ((MAX_MUSICWIN_CODE > ImageLimit(RADIOWIN_CODE)) ? MAX_MUSICWIN_CODE : ImageLimit(RADIOWIN_CODE))
    #define MAX_RADIOWIN_DATA  ((MAX_MUSICWIN_DATA > ImageLimit(RADIOWIN_DATA)) ? MAX_MUSICWIN_DATA : ImageLimit(RADIOWIN_DATA))

    ;--------------------------------------------------------------
    RECORDWIN_CODE (UI_CODE_BASE) OVERLAY                           ;RecordWin Main Code
    {
        *(RecordWinCode)
        *(RecordWinInitCode)
        *(RecordWinDeInitCode)
        *(RecordWinServiceCode)
    }
    RECORDWIN_DATA (UI_DATA_BASE) OVERLAY                           ;RecordWin Main Data
    {
        *(RecordWinData)
        *(RecordWinBss)
        *(RecordWinInitData)
        *(RecordWinDeInitData)
        *(RecordWinInitBss)
        *(RecordWinDeInitBss)
        *(RecordWinServiceData)
        *(RecordWinServiceBss)
    }
    RECORDWIN_CODE_END (ImageLimit(RECORDWIN_CODE)) OVERLAY {}
    RECORDWIN_DATA_END (ImageLimit(RECORDWIN_DATA)) OVERLAY {}
    #define MAX_RECORDWIN_CODE  ((MAX_RADIOWIN_CODE > ImageLimit(RECORDWIN_CODE)) ? MAX_RADIOWIN_CODE : ImageLimit(RECORDWIN_CODE))
    #define MAX_RECORDWIN_DATA  ((MAX_RADIOWIN_DATA > ImageLimit(RECORDWIN_DATA)) ? MAX_RADIOWIN_DATA : ImageLimit(RECORDWIN_DATA))

    ;--------------------------------------------------------------
    TEXTWIN_CODE (UI_CODE_BASE) OVERLAY                             ;TextWin Main Code
    {
        *(TextWinCode)
        *(TextWinInitCode)
        *(TextWinDeInitCode)
        *(TextWinServiceCode)
        *(BookMaskWinCode)
    }
    TEXTWIN_DATA (UI_DATA_BASE) OVERLAY                             ;TextWin Main Data
    {
        *(TextWinData)
        *(TextWinBss)
        *(TextWinInitData)
        *(TextWinDeInitData)
        *(TextWinInitBss)
        *(TextWinDeInitBss)
        *(TextWinServiceData)
        *(TextWinServiceBss)
        *(BookMaskWinData)
        *(BookMaskWinBss)
    }
    TEXTWIN_CODE_END (ImageLimit(TEXTWIN_CODE)) OVERLAY {}
    TEXTWIN_DATA_END (ImageLimit(TEXTWIN_DATA)) OVERLAY {}
    #define MAX_TEXTWIN_CODE  ((MAX_RECORDWIN_CODE > ImageLimit(TEXTWIN_CODE)) ? MAX_RECORDWIN_CODE : ImageLimit(TEXTWIN_CODE))
    #define MAX_TEXTWIN_DATA  ((MAX_RECORDWIN_DATA > ImageLimit(TEXTWIN_DATA)) ? MAX_RECORDWIN_DATA : ImageLimit(TEXTWIN_DATA))

    ;--------------------------------------------------------------
    BROWSER_CODE (UI_CODE_BASE) OVERLAY                             ;BrowserWin Main Code
    {
        *(BroUICode)
        *(BroCoreCode)
    }
    BROWSER_DATA (UI_DATA_BASE) OVERLAY                             ;BrowserWin Main Data
    {
        *(BroUIData)
        *(BroCoreData)
        *(BroUIBss)
        *(BroCoreBss)
    }
    BROWSER_CODE_END (ImageLimit(BROWSER_CODE)) OVERLAY {}
    BROWSER_DATA_END (ImageLimit(BROWSER_DATA)) OVERLAY {}
    #define MAX_BROWSERWIN_CODE  ((MAX_TEXTWIN_CODE > ImageLimit(BROWSER_CODE)) ? MAX_TEXTWIN_CODE : ImageLimit(BROWSER_CODE))
    #define MAX_BROWSERWIN_DATA  ((MAX_TEXTWIN_DATA > ImageLimit(BROWSER_DATA)) ? MAX_TEXTWIN_DATA : ImageLimit(BROWSER_DATA))

    ;--------------------------------------------------------------
    M3UBROWIN_CODE (UI_CODE_BASE) OVERLAY
    {
        *(M3uBroCode)
        *(M3uBroInitCode)
        *(M3uBroDeInitCode)
        *(M3uBroServiceCode)
    }
    M3UBROWIN_DATA (UI_DATA_BASE) OVERLAY
    {
        *(M3uBroData)
        *(M3uBroBss)
        *(M3uBroInitData)
        *(M3uBroInitBss)
        *(M3uBroDeInitData)
        *(M3uBroDeInitBss)
        *(M3uBroServiceData)
        *(M3uBroServiceBss)
    }
    M3UBRO_SORTGET_CODE (ImageLimit(M3UBROWIN_CODE)) OVERLAY
    {
        *(M3uBroSortGetCode)
    }
    M3UBRO_SORTGET_DATA (ImageLimit(M3UBROWIN_DATA)) OVERLAY
    {
        *(M3uBroSortGetData)
        *(M3uBroSortGetBss)
    }
    M3UBRO_SORTGET_CODE_END (ImageLimit(M3UBRO_SORTGET_CODE)) OVERLAY {}
    M3UBRO_SORTGET_DATA_END (ImageLimit(M3UBRO_SORTGET_DATA)) OVERLAY {}
    #define MAX_M3UBROWIN_CODE  ((MAX_BROWSERWIN_CODE > ImageLimit(M3UBRO_SORTGET_CODE)) ? MAX_BROWSERWIN_CODE : ImageLimit(M3UBRO_SORTGET_CODE))
    #define MAX_M3UBROWIN_DATA  ((MAX_BROWSERWIN_DATA > ImageLimit(M3UBRO_SORTGET_DATA)) ? MAX_BROWSERWIN_DATA : ImageLimit(M3UBRO_SORTGET_DATA))

    ;--------------------------------------------------------------
    M3U_CODE (UI_CODE_BASE) OVERLAY                             ;M3uWin Main Code
    {
        *(M3uUICode)
        *(M3uCoreCode)
    }
    M3U_DATA (UI_DATA_BASE) OVERLAY                             ;M3uWin Main Data
    {
        *(M3uUIData)
        *(M3uCoreData)

        *(M3uUIBss)
        *(M3uCoreBss)
    }
    M3U_CODE_END (ImageLimit(M3U_CODE)) OVERLAY {}
    M3U_DATA_END (ImageLimit(M3U_DATA)) OVERLAY {}
    #define MAX_M3UWIN_CODE  ((MAX_M3UBROWIN_CODE > ImageLimit(M3U_CODE)) ? MAX_M3UBROWIN_CODE : ImageLimit(M3U_CODE))
    #define MAX_M3UWIN_DATA  ((MAX_M3UBROWIN_DATA > ImageLimit(M3U_DATA)) ? MAX_M3UBROWIN_DATA : ImageLimit(M3U_DATA))

    ;--------------------------------------------------------------
    PICBROWIN_CODE (UI_CODE_BASE) OVERLAY
    {
        *(PicBroCode)
    }
    PICBROWIN_DATA (UI_DATA_BASE) OVERLAY
    {
        *(PicBroData)
        *(PicBroBss)
    }
    PICBROWIN_CODE_END (ImageLimit(PICBROWIN_CODE)) OVERLAY {}
    PICBROWIN_DATA_END (ImageLimit(PICBROWIN_DATA)) OVERLAY {}
    #define MAX_PICBROWIN_CODE  ((MAX_M3UWIN_CODE > ImageLimit(PICBROWIN_CODE)) ? MAX_M3UWIN_CODE : ImageLimit(PICBROWIN_CODE))
    #define MAX_PICBROWIN_DATA  ((MAX_M3UWIN_DATA > ImageLimit(PICBROWIN_DATA)) ? MAX_M3UWIN_DATA : ImageLimit(PICBROWIN_DATA))

    ;--------------------------------------------------------------
    PICWIN_CODE (UI_CODE_BASE) OVERLAY
    {
        *(PicWinCode)
    }
    PICWIN_DATA (UI_DATA_BASE) OVERLAY
    {
        *(PicWinData)
        *(PicWinBss)
    }
    PICWIN_CODE_END (ImageLimit(PICWIN_CODE)) OVERLAY {}
    PICWIN_DATA_END (ImageLimit(PICWIN_DATA)) OVERLAY {}
    #define MAX_PICWIN_UI_CODE  ((MAX_PICBROWIN_CODE > ImageLimit(PICWIN_CODE)) ? MAX_PICBROWIN_CODE : ImageLimit(PICWIN_CODE))
    #define MAX_PICWIN_UI_DATA  ((MAX_PICBROWIN_DATA > ImageLimit(PICWIN_DATA)) ? MAX_PICBROWIN_DATA : ImageLimit(PICWIN_DATA))

    ;--------------------------------------------------------------
    SETMENU_CODE (UI_CODE_BASE) OVERLAY                             ;SetMenuWin Main Code
    {
        *(SetMenuCode)
        *(SetCommonCode)
        *(SetMenuInitCode)
        *(SetMenuDeInitCode)
        *(SetMenuServiceCode)
    }
    SETMENU_DATA (UI_DATA_BASE) OVERLAY                             ;SetMenuWin Main Data
    {
        *(SetMenuData)
        *(SetCommonData)
        *(SetMenuBss)
        *(SetCommonBss)
        *(SetMenuInitData)
        *(SetMenuDeInitData)
        *(SetMenuInitBss)
        *(SetMenuDeInitBss)
        *(SetMenuServiceData)
        *(SetMenuServiceBss)
    }
    SETMENU_CODE_END (ImageLimit(SETMENU_CODE)) OVERLAY {}
    SETMENU_DATA_END (ImageLimit(SETMENU_DATA)) OVERLAY {}
    #define MAX_SETMENUWIN_CODE  ((MAX_PICWIN_UI_CODE > ImageLimit(SETMENU_CODE)) ? MAX_PICWIN_UI_CODE : ImageLimit(SETMENU_CODE))
    #define MAX_SETMENUWIN_DATA  ((MAX_PICWIN_UI_DATA > ImageLimit(SETMENU_DATA)) ? MAX_PICWIN_UI_DATA : ImageLimit(SETMENU_DATA))

    ;--------------------------------------------------------------
    BTWIN_CODE (UI_CODE_BASE) OVERLAY
    {
        *(BlueToothWinCode)
    }
    BTWIN_DATA (UI_DATA_BASE) OVERLAY
    {
        *(BlueToothWinData)
        *(BlueToothWinBss)
        bluetoothwin.o(+RW)
    }
    BTWIN_CODE_END (ImageLimit(BTWIN_CODE)) OVERLAY {}
    BTWIN_DATA_END (ImageLimit(BTWIN_DATA)) OVERLAY {}
    #define MAX_UI_CODE_END  ((MAX_SETMENUWIN_CODE > ImageLimit(BTWIN_CODE)) ? MAX_SETMENUWIN_CODE : ImageLimit(BTWIN_CODE))
    #define MAX_UI_DATA_END  ((MAX_SETMENUWIN_DATA > ImageLimit(BTWIN_DATA)) ? MAX_SETMENUWIN_DATA : ImageLimit(BTWIN_DATA))

    UI_CODE_END (MAX_UI_CODE_END) OVERLAY {}
    UI_DATA_END (MAX_UI_DATA_END) OVERLAY {}

;
;==============================================================================
;
;   MEDIA Update Section
;
;==============================================================================
;
    ;--------------------------------------------------------------
    ;Get ID3 Info
    AUDIO_ID3_CODE (MAX_UI_CODE_END) OVERLAY
    {
        *(Id3Code)
        *(WmaId3Code)
    }
    AUDIO_ID3_DATA (MAX_UI_DATA_END) OVERLAY
    {
        *(Id3Data)
        *(WmaId3Data)
        *(Id3Bss)
        *(WmaId3Bss)
    }

    ;Save file info
    FILE_INFO_SAVE_CODE (ImageLimit(AUDIO_ID3_CODE))   OVERLAY
    {
        *(FileInfoSaveCode)
    }
    FILE_INFO_SAVE_DATA (ImageLimit(AUDIO_ID3_DATA))   OVERLAY
    {
        *(FileInfoSaveData)
        *(FileInfoSaveBss)
    }
    FILE_INFO_SAVE_CODE_END (ImageLimit(FILE_INFO_SAVE_CODE))   OVERLAY {}
    FILE_INFO_SAVE_DATA_END (ImageLimit(FILE_INFO_SAVE_DATA))   OVERLAY {}

    ScatterAssert(ImageLimit(FILE_INFO_SAVE_CODE) < (SYS_CODE_BASE + SYS_CODE_SIZE))
    ScatterAssert(ImageLimit(FILE_INFO_SAVE_DATA) < (SYS_DATA_BASE + SYS_DATA_SIZE))

    ;--------------------------------------------------------------
    ;File Sort
    FILE_INFO_SORT_CODE (ImageLimit(MDB_WIN_CODE))   OVERLAY
    {
        *(FileInfoSortCode)
    }
    FILE_INFO_SORT_DATA (ImageLimit(MDB_WIN_DATA))   OVERLAY
    {
        *(FileInfoSortData)
        *(FileInfoSortBss)
    }
    FILE_INFO_SORT_CODE_END (ImageLimit(FILE_INFO_SORT_CODE))   OVERLAY {}
    FILE_INFO_SORT_DATA_END (ImageLimit(FILE_INFO_SORT_DATA))   OVERLAY {}

    ScatterAssert(ImageLimit(FILE_INFO_SORT_CODE) < (SYS_CODE_BASE + SYS_CODE_SIZE))
    ScatterAssert(ImageLimit(FILE_INFO_SORT_DATA) < (SYS_DATA_BASE + SYS_DATA_SIZE))

    ;--------------------------------------------------------------
    ;Filesystem get memory
    FS_MEM_GET_CODE (ImageLimit(MDB_WIN_CODE))   OVERLAY
    {
        *(FsMemGetCode)
    }

    FS_MEM_GET_DATA (ImageLimit(MDB_WIN_DATA))   OVERLAY
    {
        *(FsMemGetData)
        *(FsMemGetBss)
    }
    FS_MEM_GET_CODE_END (ImageLimit(FS_MEM_GET_CODE))   OVERLAY {}
    FS_MEM_GET_DATA_END (ImageLimit(FS_MEM_GET_DATA))   OVERLAY {}

    ScatterAssert(ImageLimit(FS_MEM_GET_CODE) < (SYS_CODE_BASE + SYS_CODE_SIZE))
    ScatterAssert(ImageLimit(FS_MEM_GET_DATA) < (SYS_DATA_BASE + SYS_DATA_SIZE))

    ;--------------------------------------------------------------
    ;FwUpgrade
    FW_UPGRADE_CODE (ImageLimit(MDB_WIN_CODE))   OVERLAY
    {
        *(FwUpgradeCode)
    }

    FW_UPGRADE_DATA (ImageLimit(MDB_WIN_DATA))   OVERLAY
    {
        *(FwUpgradeData)
        *(FwUpgradeBSS)
    }
    FW_UPGRADE_CODE_END (ImageLimit(FW_UPGRADE_CODE))   OVERLAY {}
    FW_UPGRADE_DATA_END (ImageLimit(FW_UPGRADE_DATA))   OVERLAY {}

    ScatterAssert(ImageLimit(FW_UPGRADE_CODE) < (SYS_CODE_BASE + SYS_CODE_SIZE))
    ScatterAssert(ImageLimit(FW_UPGRADE_DATA) < (SYS_DATA_BASE + SYS_DATA_SIZE))

;
;==============================================================================
;
;   Picture Decode Section, follow the UI section
;
;==============================================================================
;
    ;#define PICTURE_CODE_BASE  MAX_UI_CODE_END
    ;#define PICTURE_DATA_BASE  MAX_UI_DATA_END
    #define PICTURE_CODE_BASE   ImageLimit(AUDIO_ID3_CODE)
    #define PICTURE_DATA_BASE   ImageLimit(AUDIO_ID3_DATA)
    ;--------------------------------------------------------------
    IMAGE_CONTROL_CODE (PICTURE_CODE_BASE) OVERLAY
    {
        *(ImageContrlCode)
    }
    IMAGE_CONTROL_DATA (PICTURE_DATA_BASE) OVERLAY
    {
        *(ImageContrlData)
        *(ImageContrlBss)
    }
    JPG_DECODE_CODE (ImageLimit(IMAGE_CONTROL_CODE)) OVERLAY        ;jpg Decode Code
    {
        *(JpgDecCode)
    }
    JPG_DECODE_DATA (ImageLimit(IMAGE_CONTROL_DATA)) OVERLAY        ;jpg Decode Data
    {
        *(JpgDecData)
        *(JpgDecBss)
    }
    JPG_DECODE_CODE_END (ImageLimit(JPG_DECODE_CODE)) OVERLAY {}
    JPG_DECODE_DATA_END (ImageLimit(JPG_DECODE_DATA)) OVERLAY {}

    BMP_DECODE_CODE (ImageLimit(IMAGE_CONTROL_CODE)) OVERLAY        ;bmp Decode Code
    {
        *(BmpDecCode)
        BMPDEC.o(+RO)
    }
    BMP_DECODE_DATA (ImageLimit(IMAGE_CONTROL_DATA)) OVERLAY        ;bmp Decode Data
    {
        *(BmpDecData)
        *(BmpDecBss)
        BMPDEC.o(+RW)
        BMPDEC.o(+ZI)
    }
    BMP_DECODE_CODE_END (ImageLimit(BMP_DECODE_CODE)) OVERLAY {}
    BMP_DECODE_DATA_END (ImageLimit(BMP_DECODE_DATA)) OVERLAY {}

    #define MAX_IMAGE_CODE_END   ((ImageLimit(JPG_DECODE_CODE) > ImageLimit(BMP_DECODE_CODE)) ? ImageLimit(JPG_DECODE_CODE) : ImageLimit(BMP_DECODE_CODE))
    #define MAX_IMAGE_DATA_END   ((ImageLimit(JPG_DECODE_DATA) > ImageLimit(BMP_DECODE_DATA)) ? ImageLimit(JPG_DECODE_DATA) : ImageLimit(BMP_DECODE_DATA))
    PIC_CODE_END (MAX_IMAGE_CODE_END) OVERLAY {}
    PIC_DATA_END (MAX_IMAGE_DATA_END) OVERLAY {}

;
;==============================================================================
;
;   Audio Decode Section, follow the UI section
;
;==============================================================================
;
    #define AUDIO_CODE_BASE   MAX_IMAGE_CODE_END
    #define AUDIO_DATA_BASE   MAX_IMAGE_DATA_END
    ;--------------------------------------------------------------
    AUDIO_CONTROL_CODE (AUDIO_CODE_BASE) OVERLAY             ;AudioControl Code
    {
        *(AudioCode)
        myrandom.o(+RO)
    }
    AUDIO_CONTROL_DATA (AUDIO_DATA_BASE) OVERLAY             ;AudioControl Data
    {
        *(AudioData)
        *(AudioBss)
        myrandom.o(+RW)
        myrandom.o(+ZI)
    }
    AUDIO_CONTROL_INIT_CODE (ImageLimit(AUDIO_CONTROL_CODE)) OVERLAY
    {
        *(AudioInitCode)
    }
    AUDIO_CONTROL_INIT_DATA (ImageLimit(AUDIO_CONTROL_DATA)) OVERLAY
    {
    }
    AUDIO_CONTROL_INIT_CODE_END (ImageLimit(AUDIO_CONTROL_INIT_CODE)) OVERLAY {}
    AUDIO_CONTROL_INIT_DATA_END (ImageLimit(AUDIO_CONTROL_INIT_DATA)) OVERLAY {}

    ;EQ table, not use system space, and copy to temp buffer before use it
    AUDIO_EQ_CODE (ImageLimit(AUDIO_CONTROL_CODE)) OVERLAY              ;Eq Table Code
    {
    }
    AUDIO_EQ_DATA (ImageLimit(AUDIO_CONTROL_DATA)) OVERLAY              ;Eq Table Data
    {
        *(RkEqData)
    }

    AUDIO_RKEQ_CODE  (ImageLimit(AUDIO_CONTROL_CODE)) OVERLAY           ;Mp3 Init Code
    {
        *(RkEqCode)
    }
    AUDIO_RKEQ_DATA  (ImageLimit(AUDIO_CONTROL_DATA)) OVERLAY           ;Mp3 Init Code
    {
        *(RkEqBss)
    }
    AUDIO_RKEQ_CODE_END (ImageLimit(AUDIO_RKEQ_CODE)) OVERLAY {}
    AUDIO_RKEQ_DATA_END (ImageLimit(AUDIO_RKEQ_DATA)) OVERLAY {}

    ;---------------------------------------------------------------
    #define AUDIO_DECODE_CODE_BASE  ImageLimit(AUDIO_RKEQ_CODE)
    #define AUDIO_DECODE_DATA_BASE  ImageLimit(AUDIO_RKEQ_DATA)

    MP3_DECODE_CODE (AUDIO_DECODE_CODE_BASE) OVERLAY                    ;Mp3 Decode Code
    {
        *(Mp3InitCode)
        *(Mp3DecCode)
        *(Mp3DecDataHL)
        mp3_rom_tbl.o(+RO)
        mp3_frame.o(+RO)
    }
    MP3_DECODE_DATA (AUDIO_DECODE_DATA_BASE) OVERLAY                    ;Mp3 Decode Data
    {
        *(Mp3DecData)
        *(Mp3DecBss)
        *(Mp3InitData)
        *(Mp3InitBss)
    }
    MP3_DECODE_CODE_END (ImageLimit(MP3_DECODE_CODE)) OVERLAY {}
    MP3_DECODE_DATA_END (ImageLimit(MP3_DECODE_DATA)) OVERLAY {}

    WMA_COMMON_CODE(AUDIO_DECODE_CODE_BASE) OVERLAY                     ;Wma Comm Code
    {
        *(WmaCommonCode)
        *(WmaOpenCodecCode)
        *(WmaHighLowCommonCode)
        *(WmaHighRateCode)
        *(WmaLowRateCode)
        *(wma_16Ob)
        *(wma_44Qb)
        *(wma_44Ob)
        pwma.o(+RO)
        wmaudio.o(+RO)
        wma_drmpd.o(+RO)
        wma_msaudiostdpro.o(+RO)
    }
    WMA_COMMON_DATA (AUDIO_DECODE_DATA_BASE) OVERLAY                    ;Wma Comm Data
    {
        *(WmaDecoderData)
        *(WmaDecoderBss)
        *(WmaOpenCodecData)
        *(WmaOpenCodecBss)
        pwma.o(+RW)
        pwma.o(+ZI)
        wmaudio.o(+RW)
        wmaudio.o(+ZI)
        wma_drmpd.o(+RW)
        wma_drmpd.o(+ZI)
        wma_msaudiostdpro.o(+RW)
        wma_msaudiostdpro.o(+ZI)
    }
    WMA_COMMON_CODE_END (ImageLimit(WMA_COMMON_CODE)) OVERLAY {}
    WMA_COMMON_DATA_END (ImageLimit(WMA_COMMON_DATA)) OVERLAY {}
    #define MAX_WMA_DECODE_CODE   ((ImageLimit(MP3_DECODE_CODE) > ImageLimit(WMA_COMMON_CODE)) ? ImageLimit(MP3_DECODE_CODE) : ImageLimit(WMA_COMMON_CODE))
    #define MAX_WMA_DECODE_DATA   ((ImageLimit(MP3_DECODE_DATA) > ImageLimit(WMA_COMMON_DATA)) ? ImageLimit(MP3_DECODE_DATA) : ImageLimit(WMA_COMMON_DATA))

    WAV_DECODE_CODE (AUDIO_DECODE_CODE_BASE) OVERLAY             ;Wav Decode Code
    {
        *(WavDecInitCode)
        *(WavDecCode)
    }
    WAV_DECODE_DATA (AUDIO_DECODE_DATA_BASE) OVERLAY             ;Wav Decode Data
    {
        *(WavDecData)
        *(WavDecBss)
        *(WavDecInitData)
        *(WavDecInitBss)
        wav_msadpcm_dec.o(+RW)
    }
    WAV_DECODE_CODE_END (ImageLimit(WAV_DECODE_CODE)) OVERLAY {}
    WAV_DECODE_DATA_END (ImageLimit(WAV_DECODE_DATA)) OVERLAY {}
    #define MAX_WAV_DECODE_CODE   ((MAX_WMA_DECODE_CODE > ImageLimit(WAV_DECODE_CODE)) ? MAX_WMA_DECODE_CODE : ImageLimit(WAV_DECODE_CODE))
    #define MAX_WAV_DECODE_DATA   ((MAX_WMA_DECODE_DATA > ImageLimit(WAV_DECODE_DATA)) ? MAX_WMA_DECODE_DATA : ImageLimit(WAV_DECODE_DATA))

    FLAC_DECODE_CODE (AUDIO_DECODE_CODE_BASE) OVERLAY               ;Flac Decode Code
    {
        *(FlacDecCode)
        flac_stream_decoder.o(+RO)
        flac_format.o
        flac_tab.o
        flac_decode.o
    }
    FLAC_DECODE_DATA (AUDIO_DECODE_DATA_BASE) OVERLAY               ;Flac Decode Data
    {
        *(FlacDecData)
        *(FlacDecBss)
        flac_stream_decoder.o(+RW)
        flac_stream_decoder.o(+ZI)
    }
    FLAC_DECODE_CODE_END (ImageLimit(FLAC_DECODE_CODE)) OVERLAY {}
    FLAC_DECODE_DATA_END (ImageLimit(FLAC_DECODE_DATA)) OVERLAY {}
    #define MAX_FLAC_DECODE_CODE   ((MAX_WAV_DECODE_CODE > ImageLimit(FLAC_DECODE_CODE)) ? MAX_WAV_DECODE_CODE : ImageLimit(FLAC_DECODE_CODE))
    #define MAX_FLAC_DECODE_DATA   ((MAX_WAV_DECODE_DATA > ImageLimit(FLAC_DECODE_DATA)) ? MAX_WAV_DECODE_DATA : ImageLimit(FLAC_DECODE_DATA))

    AAC_DECODE_CODE (AUDIO_DECODE_CODE_BASE) OVERLAY                ;Aac Decode Code
    {
        *(AacDecCode)
        aac_aacdec.o
    }
    AAC_DECODE_DATA (AUDIO_DECODE_DATA_BASE) OVERLAY                ;Aac Decode Data
    {
        *(AacDecData)
        *(AacDecBss)
        *(AacROData)
    }
    AAC_DECODE_CODE_END (ImageLimit(AAC_DECODE_CODE)) OVERLAY {}
    AAC_DECODE_DATA_END (ImageLimit(AAC_DECODE_DATA)) OVERLAY {}
    #define MAX_AAC_DECODE_CODE   ((MAX_FLAC_DECODE_CODE > ImageLimit(AAC_DECODE_CODE)) ? MAX_FLAC_DECODE_CODE : ImageLimit(AAC_DECODE_CODE))
    #define MAX_AAC_DECODE_DATA   ((MAX_FLAC_DECODE_DATA > ImageLimit(AAC_DECODE_DATA)) ? MAX_FLAC_DECODE_DATA : ImageLimit(AAC_DECODE_DATA))

    AUDIO_DECODING_MAX_CODE_END (MAX_AAC_DECODE_CODE) OVERLAY {}
    AUDIO_DECODING_MAX_DATA_END (MAX_AAC_DECODE_DATA) OVERLAY {}

    ;--------------------------------------------------------------
    ;for bluletooth audio
    #define SBC_ENCODE_CODE_BASE  MAX_AAC_DECODE_CODE
    #define SBC_ENCODE_DATA_BASE  MAX_AAC_DECODE_DATA

    SBC_ENCODE_CODE (SBC_ENCODE_CODE_BASE)      OVERLAY
    {
        *(SbcEnCodeCode)
    }
    SBC_ENCODE_DATA (SBC_ENCODE_DATA_BASE)       OVERLAY
    {
        *(SbcEnCodeData)
        *(SbcEnCodeBss)
    }

    SRC_CODE(ImageLimit(SBC_ENCODE_CODE))               OVERLAY
    {
        *(SSRCCode)
    }
    SRC_DATA(ImageLimit(SBC_ENCODE_DATA))               OVERLAY
    {
        *(SSRCData)
    }

    SRC_TABLE_CODE_48_44(ImageLimit(SRC_CODE)) OVERLAY
    {
        *(srctable48_44)
    }
    SRC_TABLE_DATA_48_44(ImageLimit(SRC_DATA) ) OVERLAY
    {
    }
    SRC_TABLE_CODE_32_44(ImageLimit(SRC_CODE)) OVERLAY
    {
        *(srctable32_44)
    }
    SRC_TABLE_DATA_32_44(ImageLimit(SRC_DATA) ) OVERLAY
    {
    }
    #define MAX_SRC_TABLE_CODE_32   ((ImageLimit(SRC_TABLE_CODE_48_44) > ImageLimit(SRC_TABLE_CODE_32_44)) ? ImageLimit(SRC_TABLE_CODE_48_44) : ImageLimit(SRC_TABLE_CODE_32_44))
    #define MAX_SRC_TABLE_DATA_32   ((ImageLimit(SRC_TABLE_DATA_48_44) > ImageLimit(SRC_TABLE_DATA_32_44)) ? ImageLimit(SRC_TABLE_DATA_48_44) : ImageLimit(SRC_TABLE_DATA_32_44))

    SRC_TABLE_CODE_24_44(ImageLimit(SRC_CODE)) OVERLAY
    {
        *(srctable24_44)
    }
    SRC_TABLE_DATA_24_44(ImageLimit(SRC_DATA) ) OVERLAY
    {
    }
    #define MAX_SRC_TABLE_CODE_24   ((MAX_SRC_TABLE_CODE_32 > ImageLimit(SRC_TABLE_CODE_24_44)) ? MAX_SRC_TABLE_CODE_32 : ImageLimit(SRC_TABLE_CODE_24_44))
    #define MAX_SRC_TABLE_DATA_24   ((MAX_SRC_TABLE_DATA_32 > ImageLimit(SRC_TABLE_DATA_24_44)) ? MAX_SRC_TABLE_DATA_32 : ImageLimit(SRC_TABLE_DATA_24_44))

    SRC_TABLE_CODE_22_44(ImageLimit(SRC_CODE)) OVERLAY
    {
        *(srctable22_44)
    }
    SRC_TABLE_DATA_22_44(ImageLimit(SRC_DATA) ) OVERLAY
    {
    }
    #define MAX_SRC_TABLE_CODE_22   ((MAX_SRC_TABLE_CODE_24 > ImageLimit(SRC_TABLE_CODE_22_44)) ? MAX_SRC_TABLE_CODE_24 : ImageLimit(SRC_TABLE_CODE_22_44))
    #define MAX_SRC_TABLE_DATA_22   ((MAX_SRC_TABLE_DATA_24 > ImageLimit(SRC_TABLE_DATA_22_44)) ? MAX_SRC_TABLE_DATA_24 : ImageLimit(SRC_TABLE_DATA_22_44))

    SRC_TABLE_CODE_16_44(ImageLimit(SRC_CODE)) OVERLAY
    {
        *(srctable16_44)
    }
    SRC_TABLE_DATA_16_44(ImageLimit(SRC_DATA) ) OVERLAY
    {
    }
    #define MAX_SRC_TABLE_CODE_16   ((MAX_SRC_TABLE_CODE_22 > ImageLimit(SRC_TABLE_CODE_16_44)) ? MAX_SRC_TABLE_CODE_22 : ImageLimit(SRC_TABLE_CODE_16_44))
    #define MAX_SRC_TABLE_DATA_16   ((MAX_SRC_TABLE_DATA_22 > ImageLimit(SRC_TABLE_DATA_16_44)) ? MAX_SRC_TABLE_DATA_22 : ImageLimit(SRC_TABLE_DATA_16_44))

    SRC_TABLE_CODE_12_44(ImageLimit(SRC_CODE)) OVERLAY
    {
        *(srctable12_44)
    }
    SRC_TABLE_DATA_12_44(ImageLimit(SRC_DATA) ) OVERLAY
    {
    }
    #define MAX_SRC_TABLE_CODE_12   ((MAX_SRC_TABLE_CODE_16 > ImageLimit(SRC_TABLE_CODE_12_44)) ? MAX_SRC_TABLE_CODE_16 : ImageLimit(SRC_TABLE_CODE_12_44))
    #define MAX_SRC_TABLE_DATA_12   ((MAX_SRC_TABLE_DATA_16 > ImageLimit(SRC_TABLE_DATA_12_44)) ? MAX_SRC_TABLE_DATA_16 : ImageLimit(SRC_TABLE_DATA_12_44))

    SRC_TABLE_CODE_11_44(ImageLimit(SRC_CODE)) OVERLAY
    {
        *(srctable11_44)
    }
    SRC_TABLE_DATA_11_44(ImageLimit(SRC_DATA) ) OVERLAY
    {
    }
    #define MAX_SRC_TABLE_CODE_11   ((MAX_SRC_TABLE_CODE_12 > ImageLimit(SRC_TABLE_CODE_11_44)) ? MAX_SRC_TABLE_CODE_12 : ImageLimit(SRC_TABLE_CODE_11_44))
    #define MAX_SRC_TABLE_DATA_11   ((MAX_SRC_TABLE_DATA_12 > ImageLimit(SRC_TABLE_DATA_11_44)) ? MAX_SRC_TABLE_DATA_12 : ImageLimit(SRC_TABLE_DATA_11_44))

    SRC_TABLE_CODE_8_44(ImageLimit(SRC_CODE)) OVERLAY
    {
        *(srctable8_44)
    }
    SRC_TABLE_DATA_8_44(ImageLimit(SRC_DATA) ) OVERLAY
    {
    }
    #define MAX_SRC_TABLE_CODE_8   ((MAX_SRC_TABLE_CODE_11 > ImageLimit(SRC_TABLE_CODE_8_44)) ? MAX_SRC_TABLE_CODE_11 : ImageLimit(SRC_TABLE_CODE_8_44))
    #define MAX_SRC_TABLE_DATA_8   ((MAX_SRC_TABLE_DATA_11 > ImageLimit(SRC_TABLE_DATA_8_44)) ? MAX_SRC_TABLE_DATA_11 : ImageLimit(SRC_TABLE_DATA_8_44))

    SRC_TABLE_CODE_48_44120(ImageLimit(SRC_CODE)) OVERLAY
    {
        *(srctable48_44120)
    }
    SRC_TABLE_DATA_48_44120(ImageLimit(SRC_DATA) ) OVERLAY
    {
    }
    #define MAX_SRC_TABLE_CODE_48   ((MAX_SRC_TABLE_CODE_8 > ImageLimit(SRC_TABLE_CODE_48_44120)) ? MAX_SRC_TABLE_CODE_8 : ImageLimit(SRC_TABLE_CODE_48_44120))
    #define MAX_SRC_TABLE_DATA_48   ((MAX_SRC_TABLE_DATA_8 > ImageLimit(SRC_TABLE_DATA_48_44120)) ? MAX_SRC_TABLE_DATA_8 : ImageLimit(SRC_TABLE_DATA_48_44120))

    SRC_TABLE_CODE_44_44120(ImageLimit(SRC_CODE)) OVERLAY
    {
        *(srctable44_44120)
    }
    SRC_TABLE_DATA_44_44120(ImageLimit(SRC_DATA) ) OVERLAY
    {
    }
    #define MAX_SRC_TABLE_CODE_44   ((MAX_SRC_TABLE_CODE_48 > ImageLimit(SRC_TABLE_CODE_44_44120)) ? MAX_SRC_TABLE_CODE_48 : ImageLimit(SRC_TABLE_CODE_44_44120))
    #define MAX_SRC_TABLE_DATA_44   ((MAX_SRC_TABLE_DATA_48 > ImageLimit(SRC_TABLE_DATA_44_44120)) ? MAX_SRC_TABLE_DATA_48 : ImageLimit(SRC_TABLE_DATA_44_44120))

    SRC_TABLE_CODE_END (MAX_SRC_TABLE_CODE_44) OVERLAY {}
    SRC_TABLE_DATA_END (MAX_SRC_TABLE_DATA_44) OVERLAY {}

;
;==============================================================================
;
;   Bluetooth Data Section
;
;==============================================================================
;
    #define BT_CODE_BASE   MAX_SRC_TABLE_CODE_44
    #define BT_DATA_BASE   MAX_SRC_TABLE_DATA_44
    ;--------------------------------------------------------------
    BTCONTROL_CODE (BT_CODE_BASE) OVERLAY
    {
        *(BlueToothControlCode)
        bluetoothcontrol.o(+RO)
    }
    BTCONTROL_DATA (BT_DATA_BASE) OVERLAY
    {
        *(BlueToothControlData)
        *(BlueToothControlBss)
    }

    LWBT_INIT_CODE (ImageLimit(BTCONTROL_CODE)) OVERLAY
    {
        *(LwbtInitCode)
    }
    LWBT_INIT_DATA (ImageLimit(BTCONTROL_DATA)) OVERLAY
    {
        *(LwbtInitData)
        *(LwbtInitBss)
    }
    LWBT_INIT_CODE_END (ImageLimit(LWBT_INIT_CODE)) OVERLAY {}
    LWBT_INIT_DATA_END (ImageLimit(LWBT_INIT_DATA)) OVERLAY {}

    LWBT_UARTIF_CODE (ImageLimit(LWBT_INIT_CODE)) OVERLAY
    {
        *(LwbtUartifCode)
    }
    LWBT_UARTIF_DATA (ImageLimit(LWBT_INIT_DATA)) OVERLAY
    {
        *(LwbtUartifData)
        *(LwbtUartifBss)
    }

    LWBT_CODE (ImageLimit(LWBT_UARTIF_CODE)) OVERLAY
    {
        *(LwbtCode)
        hsp_hfp.o(+RO)
    }
    LWBT_DATA (ImageLimit(LWBT_UARTIF_DATA)) OVERLAY
    {
        *(LwbtData)
        *(LwbtBss)
    }
    LWBT_CODE_END (ImageLimit(LWBT_CODE)) OVERLAY {}
    LWBT_DATA_END (ImageLimit(LWBT_DATA)) OVERLAY {}

    ScatterAssert(ImageLimit(LWBT_CODE) < (SYS_CODE_BASE + SYS_CODE_SIZE))
    ScatterAssert(ImageLimit(LWBT_DATA) < (SYS_DATA_BASE + SYS_DATA_SIZE))

;
;==============================================================================
;
;   Record Section
;
;==============================================================================
;
    #define RECORD_CODE_BASE   MAX_UI_CODE_END
    #define RECORD_DATA_BASE   MAX_UI_DATA_END

    RECORD_CONTROL_CODE (RECORD_CODE_BASE) OVERLAY
    {
        *(RecordControlCode)
        *(NSCode)
    }
    RECORD_CONTROL_DATA (RECORD_DATA_BASE) OVERLAY
    {
        *(RecordControlData)
        *(RecordControlBss)
        *(NSData)
        *(NSBss)
        ns_interface.o(+RW)
        ns_interface.o(+ZI)
    }

    ENCODE_MSADPCM_CODE(ImageLimit(RECORD_CONTROL_CODE)) OVERLAY
    {
        *(EncodeMsadpcmCode)
    }
    ENCODE_MSADPCM_DATA(ImageLimit(RECORD_CONTROL_DATA)) OVERLAY
    {
        *(EncodeMsadpcmData)
        *(EncodeMsadpcmBss)
    }
    ENCODE_MSADPCM_CODE_END (ImageLimit(ENCODE_MSADPCM_CODE)) OVERLAY {}
    ENCODE_MSADPCM_DATA_END (ImageLimit(ENCODE_MSADPCM_DATA)) OVERLAY {}

    ENCODE_MP3_CODE(ImageLimit(RECORD_CONTROL_CODE)) OVERLAY
    {
        *(EncodeMP3Code)
    }

    ENCODE_MP3_DATA(ImageLimit(RECORD_CONTROL_DATA)) OVERLAY
    {
         *(EncodeMP3Data)
         *(EncodeMP3Bss)
    }
    ENCODE_MP3_CODE_END (ImageLimit(ENCODE_MP3_CODE)) OVERLAY {}
    ENCODE_MP3_DATA_END (ImageLimit(ENCODE_MP3_DATA)) OVERLAY {}

    #define MAX_RECORD_CODE   ((ImageLimit(ENCODE_MSADPCM_CODE) > ImageLimit(ENCODE_MP3_CODE)) ? ImageLimit(ENCODE_MSADPCM_CODE) : ImageLimit(ENCODE_MP3_CODE))
    #define MAX_RECORD_DATA   ((ImageLimit(ENCODE_MSADPCM_DATA) > ImageLimit(ENCODE_MP3_DATA)) ? ImageLimit(ENCODE_MSADPCM_DATA) : ImageLimit(ENCODE_MP3_DATA))
    RECORD_CODE_END (MAX_RECORD_CODE) OVERLAY {}
    RECORD_DATA_END (MAX_RECORD_DATA) OVERLAY {}
;
;==============================================================================
;
;   FM Radio Section, followed Record section and Picture section
;
;==============================================================================
;
    #define FM_CODE_BASE   ((MAX_RECORD_CODE > MAX_IMAGE_CODE_END) ? MAX_RECORD_CODE : MAX_IMAGE_CODE_END)
    #define FM_DATA_BASE   ((MAX_RECORD_DATA > MAX_IMAGE_DATA_END) ? MAX_RECORD_DATA : MAX_IMAGE_DATA_END)

    FM_CONTROL_CODE (FM_CODE_BASE)   OVERLAY
    {
        *(FmControlCode )
    }
    FM_CONTROL_DATA (FM_DATA_BASE)   OVERLAY
    {
        *(FmControlData)
        *(FmControlBss)
    }

    FM_DRIVER1_CODE (ImageLimit(FM_CONTROL_CODE))           OVERLAY
    {
        *(Qn8035DriverCode)
    }
    FM_DRIVER1_DATA (ImageLimit(FM_CONTROL_DATA))           OVERLAY
    {
        *(Qn8035DriverData)
        *(Qn8035DriverBss)
    }

    FM_DRIVER2_CODE (ImageLimit(FM_CONTROL_CODE))           OVERLAY
    {
        *(Fm5807DriverCode)
    }
    FM_DRIVER2_DATA (ImageLimit(FM_CONTROL_DATA))           OVERLAY
    {
        *(Fm5807DriverData)
        *(Fm5807DriverBss)
    }
    #define MAX_RADIO_DRIVE_CODE        ((ImageLimit(FM_DRIVER1_CODE) > ImageLimit(FM_DRIVER2_CODE)) ? ImageLimit(FM_DRIVER1_CODE) : ImageLimit(FM_DRIVER2_CODE))
    #define MAX_RADIO_DRIVE_DATA        ((ImageLimit(FM_DRIVER1_DATA) > ImageLimit(FM_DRIVER2_DATA)) ? ImageLimit(FM_DRIVER2_DATA) : ImageLimit(FM_DRIVER2_DATA))
    FM_CODE_END (MAX_RADIO_DRIVE_CODE) OVERLAY {}
    FM_DATA_END (MAX_RADIO_DRIVE_DATA) OVERLAY {}

    ScatterAssert(MAX_RADIO_DRIVE_CODE < (SYS_CODE_BASE + SYS_CODE_SIZE))
    ScatterAssert(MAX_RADIO_DRIVE_DATA < (SYS_DATA_BASE + SYS_DATA_SIZE))
;
;==============================================================================
;
;   Reboot Tag
;
;==============================================================================
;
    REBOOT_TAG_DATA (SYS_CODE_LIMIT -0x0010)
    {
        *(RebootFlag)
    }
;
;==============================================================================
;
;   PMU Section
;
;==============================================================================
;
    PMU_CODE PMU_CODE_BASE OVERLAY
    {
    }
    PMU_DATA PMU_DATA_BASE OVERLAY
    {
    }
    ScatterAssert(ImageLimit(PMU_CODE) < (PMU_CODE_BASE + PMU_CODE_SIZE))
    ScatterAssert(ImageLimit(PMU_DATA) < (PMU_DATA_BASE + PMU_DATA_SIZE))
;
;==============================================================================
;
;   BB Section
;
;==============================================================================
;
    BB_SYS_CODE(HRAM_CODE_BASE) OVERLAY
    {
        *(BBSysCode)
    }
    BB_SYS_DATA (HRAM_DATA_BASE) OVERLAY
    {
        *(BBSysData)
        *(BBSysBss)
    }
    ScatterAssert(ImageLimit(BB_SYS_CODE) < (HRAM_CODE_BASE + HRAM_CODE_SIZE))
    ScatterAssert(ImageLimit(BB_SYS_DATA) < (HRAM_DATA_BASE + HRAM_DATA_SIZE))

    #define HAUDIO_DECODE_CODE_BASE  (HRAM_CODE_BASE)
    #define HAUDIO_DECODE_DATA_BASE  (HRAM_DATA_BASE)

    ;---------------------------------------------------------------
    ;Mp3 Encode Bin
    MP3_ENCODE_BIN_CODE (HAUDIO_DECODE_CODE_BASE) OVERLAY                    ;Mp3 Decode Code
    {
        *(Mp3EncBinCode)
    }
    MP3_ENCODE_BIN_DATA (HAUDIO_DECODE_DATA_BASE) OVERLAY                    ;Mp3 Decode Data
    {
        *(Mp3EncBinData)
        *(Mp3EncBinBss)
    }
    MP3_ENCODE_BIN_CODE_END (ImageLimit(MP3_ENCODE_BIN_CODE)) OVERLAY {}
    MP3_ENCODE_BIN_DATA_END (ImageLimit(MP3_ENCODE_BIN_DATA)) OVERLAY {}
    ScatterAssert(ImageLimit(MP3_ENCODE_BIN_CODE) < (HRAM_CODE_BASE + HRAM_CODE_SIZE))
    ScatterAssert(ImageLimit(MP3_ENCODE_BIN_DATA) < (HRAM_DATA_BASE + HRAM_DATA_SIZE))

    ;---------------------------------------------------------------
    ;Mp3 Decode Bin
    MP3_DECODE_BIN_CODE (HAUDIO_DECODE_CODE_BASE) OVERLAY                    ;Mp3 Decode Code
    {
        *(Mp3DecBinCode)
    }
    MP3_DECODE_BIN_DATA (HAUDIO_DECODE_DATA_BASE) OVERLAY                    ;Mp3 Decode Data
    {
        *(Mp3DecBinData)
        *(Mp3DecBinBss)
    }
    MP3_DECODE_BIN_CODE_END (ImageLimit(MP3_DECODE_BIN_CODE)) OVERLAY {}
    MP3_DECODE_BIN_DATA_END (ImageLimit(MP3_DECODE_BIN_DATA)) OVERLAY {}
    ScatterAssert(ImageLimit(MP3_DECODE_BIN_CODE) < (HRAM_CODE_BASE + HRAM_CODE_SIZE))
    ScatterAssert(ImageLimit(MP3_DECODE_BIN_DATA) < (HRAM_DATA_BASE + HRAM_DATA_SIZE))

    ;---------------------------------------------------------------
    ;Wma Decode Bin
    WMA_DECODE_BIN_CODE (HAUDIO_DECODE_CODE_BASE) OVERLAY                    ;Mp3 Decode Code
    {
        *(WmaCommonBinCode)
    }
    WMA_DECODE_BIN_DATA (HAUDIO_DECODE_DATA_BASE) OVERLAY                    ;Mp3 Decode Data
    {
        *(WmaCommonBinData)
        *(WmaCommonBinBss)
    }
    WMA_DECODE_BIN_CODE_END (ImageLimit(WMA_DECODE_BIN_CODE)) OVERLAY {}
    WMA_DECODE_BIN_DATA_END (ImageLimit(WMA_DECODE_BIN_DATA)) OVERLAY {}
    ScatterAssert(ImageLimit(WMA_DECODE_BIN_CODE) < (HRAM_CODE_BASE + HRAM_CODE_SIZE))
    ScatterAssert(ImageLimit(WMA_DECODE_BIN_DATA) < (HRAM_DATA_BASE + HRAM_DATA_SIZE))

    ;---------------------------------------------------------------
    ;Wav Decode Bin
    WAV_DECODE_BIN_CODE (HAUDIO_DECODE_CODE_BASE) OVERLAY                    ;Mp3 Decode Code
    {
        *(WavDecBinCode)
    }
    WAV_DECODE_BIN_DATA (HAUDIO_DECODE_DATA_BASE) OVERLAY                    ;Mp3 Decode Data
    {
        *(WavDecBinData)
        *(WavDecBinBss)
    }
    WAV_DECODE_BIN_CODE_END (ImageLimit(WAV_DECODE_BIN_CODE)) OVERLAY {}
    WAV_DECODE_BIN_DATA_END (ImageLimit(WAV_DECODE_BIN_DATA)) OVERLAY {}
    ScatterAssert(ImageLimit(WAV_DECODE_BIN_CODE) < (HRAM_CODE_BASE + HRAM_CODE_SIZE))
    ScatterAssert(ImageLimit(WAV_DECODE_BIN_DATA) < (HRAM_DATA_BASE + HRAM_DATA_SIZE))

    ;---------------------------------------------------------------
    ;Flac Decode Bin
    FLAC_DECODE_BIN_CODE (HAUDIO_DECODE_CODE_BASE) OVERLAY                    ;flac Decode Code
    {
        *(FlacDecBinCode)
    }
    FLAC_DECODE_BIN_DATA (HAUDIO_DECODE_DATA_BASE) OVERLAY                    ;flac Decode Data
    {
        *(FlacDecBinData)
        *(FlacDecBinBss)
    }
    FLAC_DECODE_BIN_CODE_END (ImageLimit(FLAC_DECODE_BIN_CODE)) OVERLAY {}
    FLAC_DECODE_BIN_DATA_END (ImageLimit(FLAC_DECODE_BIN_DATA)) OVERLAY {}
    ScatterAssert(ImageLimit(FLAC_DECODE_BIN_CODE) < (HRAM_CODE_BASE + HRAM_CODE_SIZE))
    ScatterAssert(ImageLimit(FLAC_DECODE_BIN_DATA) < (HRAM_DATA_BASE + HRAM_DATA_SIZE))

    ;---------------------------------------------------------------
    ;AAC Decode Bin
    AAC_DECODE_BIN_CODE (HAUDIO_DECODE_CODE_BASE) OVERLAY                    ;Mp3 Decode Code
    {
        *(AacDecBinCode)
    }
    AAC_DECODE_BIN_DATA (HAUDIO_DECODE_DATA_BASE) OVERLAY                    ;Mp3 Decode Data
    {
        *(AacDecBinData)
        *(AacDecBinBss)
    }
    AAC_DECODE_BIN_CODE_END (ImageLimit(AAC_DECODE_BIN_CODE)) OVERLAY {}
    AAC_DECODE_BIN_DATA_END (ImageLimit(AAC_DECODE_BIN_DATA)) OVERLAY {}
    ScatterAssert(ImageLimit(AAC_DECODE_BIN_CODE) < (HRAM_CODE_BASE + HRAM_CODE_SIZE))
    ScatterAssert(ImageLimit(AAC_DECODE_BIN_DATA) < (HRAM_DATA_BASE + HRAM_DATA_SIZE))
}

;*******************************************************************************
